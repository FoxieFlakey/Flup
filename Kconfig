## Kconfig
```kconfig
mainmenu "FluffedUpLibC"

config VERSION_MAJOR
  int 
  default 1

config VERSION_MINOR
  int 
  default 7

config VERSION_PATCH
  int 
  default 1

config DISABLE_GNU_API
  bool "Disables use of GNU API and fallback to portable only"

config ENABLE_TEST_EXE
  bool "Enable main"

config ASAN
  bool "Enable ASAN"
config TSAN
  bool "Enable TSAN"
config MSAN
  bool "Enable MSAN"
config UBSAN
  bool "Enable UBSAN"

menu "Installation"
  config PREFIX
    string 
    prompt "The usual $PREFIX you see on programs"  
    default "/usr/local"
endmenu

source "c23_support/Kconfig"
```

## c23_support/Kconfig
```kconfig
menu "C23 support"
  config HAS_STDBIT
    bool
    default $[[$PROJECT_DIR/scripts/check_header.sh stdbit.h]]
  config HAS_STDCKINT
    bool
    default $[[$PROJECT_DIR/scripts/check_header.sh stdckint.h]]
    
  config USE_BUILTIN_STDBIT
    bool "Use this project's stdbit.h"
    default y if !HAS_STDBIT
    help
      This is available for users' compiler's which
      don't shipped C23's stdbit.h or the compiler's
      stdbit.h is buggy. Most of time leave this
      at default value
      
      The default value automaticly selected to be
      either 'y' or 'n' depends on detection.
  
  config USE_BUILTIN_STDCKINT
    bool "Use this project's stdckint.h"
    default y if !HAS_STDCKINT
    help
      This is available for users' compiler's which
      don't shipped C23's stdckint.h or the compiler's
      stdckint.h is buggy. Most of time leave this
      at default value
      
      The default value automaticly selected to be
      either 'y' or 'n' depends on detection.
endmenu
```
